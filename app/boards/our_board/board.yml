## app/boards/our_board/board.yml
```yaml
board:
  name: our_board
  full_name: Our Board
  vendor: iomico
  socs:
  - name: esp32s3
```

## app/build/Kconfig/Kconfig.modules
```kconfig
menu "cmsis_6 (D:/zephyr-course/deps/modules/hal/cmsis_6)"
osource "$(ZEPHYR_CMSIS_6_KCONFIG)"
config ZEPHYR_CMSIS_6_MODULE
	bool
	default y
endmenu
menu "hal_espressif (D:/zephyr-course/deps/modules/hal/espressif)"
osource "$(ZEPHYR_HAL_ESPRESSIF_KCONFIG)"
config ZEPHYR_HAL_ESPRESSIF_MODULE
	bool
	default y

config ZEPHYR_HAL_ESPRESSIF_MODULE_BLOBS
	bool
endmenu
menu "hal_nordic (D:/zephyr-course/deps/modules/hal/nordic)"
osource "$(ZEPHYR_HAL_NORDIC_KCONFIG)"
config ZEPHYR_HAL_NORDIC_MODULE
	bool
	default y

config ZEPHYR_HAL_NORDIC_MODULE_BLOBS
	bool
endmenu
config ZEPHYR_HAL_STM32_MODULE
	bool
	default y

config ZEPHYR_HAL_STM32_MODULE_BLOBS
	bool
```

## app/build/Kconfig/boards/Kconfig.defconfig
```kconfig
# Load Zephyr board defconfig descriptions.
osource "D:/zephyr-course/boards/our_board/Kconfig.defconfig"
```

## app/build/Kconfig/boards/Kconfig.defconfig.tmp
```kconfig
# Load Zephyr board defconfig descriptions.
osource "D:/zephyr-course/boards/my_board/Kconfig.defconfig"
```

## app/build/Kconfig/boards/Kconfig.esp32s3_devkitc
```kconfig
# Load board Kconfig descriptions.
osource "D:/zephyr-course/deps/zephyr/boards/espressif/esp32s3_devkitc/Kconfig.esp32s3_devkitc"
```

## app/build/Kconfig/boards/Kconfig.sysbuild
```kconfig
# Load Sysbuild board Kconfig descriptions.
osource "D:/zephyr-course/boards/our_board/Kconfig.sysbuild"
```

## app/build/Kconfig/boards/Kconfig.sysbuild.tmp
```kconfig
# Load Sysbuild board Kconfig descriptions.
osource "D:/zephyr-course/boards/my_board/Kconfig.sysbuild"
```

## app/build/Kconfig/boards/Kconfig.tmp
```kconfig
# Load Zephyr board Kconfig descriptions.
osource "D:/zephyr-course/boards/my_board/Kconfig"
```

## boards/my_board/Kconfig
```kconfig
config HEAP_MEM_POOL_ADD_SIZE_BOARD
	int
	default 4096 if BOARD_MY_BOARD_ESP32S3_PROCPU
```

## boards/my_board/Kconfig.my_board
```kconfig
config BOARD_MY_BOARD
	select SOC_ESP32S3_WROOM_N8
	select SOC_ESP32S3_PROCPU if BOARD_MY_BOARD_ESP32S3_PROCPU
```

## boards/my_board/board.yml
```yaml
board:
  name: my_board
  full_name: My Board
  vendor: iomico
  socs:
  - name: esp32s3
```

## lecture3/build/Kconfig/arch/Kconfig.tmp
```kconfig
# Load Zephyr Arch Kconfig descriptions.
osource "D:/zephyr-course/deps/zephyr/arch/rx/Kconfig"
osource "D:/zephyr-course/deps/zephyr/arch/x86/Kconfig"
osource "D:/zephyr-course/deps/zephyr/arch/xtensa/Kconfig"
osource "D:/zephyr-course/deps/zephyr/arch/sparc/Kconfig"
osource "D:/zephyr-course/deps/zephyr/arch/riscv/Kconfig"
osource "D:/zephyr-course/deps/zephyr/arch/posix/Kconfig"
osource "D:/zephyr-course/deps/zephyr/arch/openrisc/Kconfig"
osource "D:/zephyr-course/deps/zephyr/arch/mips/Kconfig"
osource "D:/zephyr-course/deps/zephyr/arch/arm64/Kconfig"
osource "D:/zephyr-course/deps/zephyr/arch/arm/Kconfig"
osource "D:/zephyr-course/deps/zephyr/arch/arc/Kconfig"
```

## lecture3/build/Kconfig/boards/Kconfig.defconfig
```kconfig
# Load Zephyr board defconfig descriptions.
osource "D:/zephyr-course/deps/zephyr/boards/espressif/esp32s3_devkitc/Kconfig.defconfig"
```

## lecture3/build/Kconfig/boards/Kconfig.tmp
```kconfig
# Load Zephyr board Kconfig descriptions.
osource "D:/zephyr-course/deps/zephyr/boards/espressif/esp32s3_devkitc/Kconfig"
```

## lecture3/build/Kconfig/soc/Kconfig
```kconfig
# Load Zephyr SoC Kconfig descriptions.
osource "D:/zephyr-course/deps/zephyr/soc/xlnx/zynqmp/Kconfig"
osource "D:/zephyr-course/deps/zephyr/soc/xlnx/zynq7000/Kconfig"
osource "D:/zephyr-course/deps/zephyr/soc/xlnx/versalnet/Kconfig"
osource "D:/zephyr-course/deps/zephyr/soc/xlnx/versal2/Kconfig"
osource "D:/zephyr-course/deps/zephyr/soc/xlnx/versal/Kconfig"
osource "D:/zephyr-course/deps/zephyr/soc/xen/Kconfig"
osource "D:/zephyr-course/deps/zephyr/soc/wch/ch32v/Kconfig"
osource "D:/zephyr-course/deps/zephyr/soc/ti/simplelink/Kconfig"
osource "D:/zephyr-course/deps/zephyr/soc/ti/mspm0/Kconfig"
osource "D:/zephyr-course/deps/zephyr/soc/ti/lm3s6965/Kconfig"
osource "D:/zephyr-course/deps/zephyr/soc/ti/k3/Kconfig"
osource "D:/zephyr-course/deps/zephyr/soc/telink/tlsr/Kconfig"
osource "D:/zephyr-course/deps/zephyr/soc/syna/sr100/Kconfig"
osource "D:/zephyr-course/deps/zephyr/soc/starfive/jh71xx/Kconfig"
osource "D:/zephyr-course/deps/zephyr/soc/st/stm32/Kconfig"
osource "D:/zephyr-course/deps/zephyr/soc/snps/qemu_arc/Kconfig"
osource "D:/zephyr-course/deps/zephyr/soc/snps/nsim/arc_v/Kconfig"
osource "D:/zephyr-course/deps/zephyr/soc/snps/nsim/arc_classic/Kconfig"
osource "D:/zephyr-course/deps/zephyr/soc/snps/hsdk4xd/Kconfig"
osource "D:/zephyr-course/deps/zephyr/soc/snps/hsdk/Kconfig"
osource "D:/zephyr-course/deps/zephyr/soc/snps/emsk/Kconfig"
osource "D:/zephyr-course/deps/zephyr/soc/snps/emsdp/Kconfig"
osource "D:/zephyr-course/deps/zephyr/soc/snps/arc_iot/Kconfig"
osource "D:/zephyr-course/deps/zephyr/soc/silabs/Kconfig"
osource "D:/zephyr-course/deps/zephyr/soc/sifli/sf32/Kconfig"
osource "D:/zephyr-course/deps/zephyr/soc/sifive/sifive_freedom/Kconfig"
osource "D:/zephyr-course/deps/zephyr/soc/sensry/Kconfig"
osource "D:/zephyr-course/deps/zephyr/soc/rockchip/Kconfig"
osource "D:/zephyr-course/deps/zephyr/soc/renode/riscv_virtual/Kconfig"
osource "D:/zephyr-course/deps/zephyr/soc/renode/cortex_r8_virtual/Kconfig"
osource "D:/zephyr-course/deps/zephyr/soc/renesas/smartbond/Kconfig"
osource "D:/zephyr-course/deps/zephyr/soc/renesas/rz/Kconfig"
osource "D:/zephyr-course/deps/zephyr/soc/renesas/rx/Kconfig"
osource "D:/zephyr-course/deps/zephyr/soc/renesas/rcar/Kconfig"
osource "D:/zephyr-course/deps/zephyr/soc/renesas/ra/Kconfig"
osource "D:/zephyr-course/deps/zephyr/soc/realtek/fingerprint/Kconfig"
osource "D:/zephyr-course/deps/zephyr/soc/realtek/ec/Kconfig"
osource "D:/zephyr-course/deps/zephyr/soc/realtek/bee/Kconfig"
osource "D:/zephyr-course/deps/zephyr/soc/realtek/ameba/Kconfig"
osource "D:/zephyr-course/deps/zephyr/soc/raspberrypi/rpi_pico/Kconfig"
osource "D:/zephyr-course/deps/zephyr/soc/quicklogic/eos_s3/Kconfig"
osource "D:/zephyr-course/deps/zephyr/soc/qemu/virt_riscv/Kconfig"
osource "D:/zephyr-course/deps/zephyr/soc/qemu/or1k/Kconfig"
osource "D:/zephyr-course/deps/zephyr/soc/qemu/malta/Kconfig"
osource "D:/zephyr-course/deps/zephyr/soc/openisa/rv32m1/Kconfig"
osource "D:/zephyr-course/deps/zephyr/soc/openhwgroup/cva6/Kconfig"
osource "D:/zephyr-course/deps/zephyr/soc/oct/osd32mp15x/Kconfig"
osource "D:/zephyr-course/deps/zephyr/soc/nxp/s32/Kconfig"
osource "D:/zephyr-course/deps/zephyr/soc/nxp/rw/Kconfig"
osource "D:/zephyr-course/deps/zephyr/soc/nxp/mcx/Kconfig"
osource "D:/zephyr-course/deps/zephyr/soc/nxp/lpc/Kconfig"
osource "D:/zephyr-course/deps/zephyr/soc/nxp/layerscape/Kconfig"
osource "D:/zephyr-course/deps/zephyr/soc/nxp/kinetis/Kconfig"
osource "D:/zephyr-course/deps/zephyr/soc/nxp/imxrt/Kconfig"
osource "D:/zephyr-course/deps/zephyr/soc/nxp/imx/Kconfig"
osource "D:/zephyr-course/deps/zephyr/soc/nuvoton/numicro/Kconfig"
osource "D:/zephyr-course/deps/zephyr/soc/nuvoton/numaker/Kconfig"
osource "D:/zephyr-course/deps/zephyr/soc/nuvoton/npcx/Kconfig"
osource "D:/zephyr-course/deps/zephyr/soc/nuvoton/npcm/Kconfig"
osource "D:/zephyr-course/deps/zephyr/soc/nordic/Kconfig"
osource "D:/zephyr-course/deps/zephyr/soc/neorv32/Kconfig"
osource "D:/zephyr-course/deps/zephyr/soc/native/inf_clock/Kconfig"
osource "D:/zephyr-course/deps/zephyr/soc/microchip/sam/sama7/Kconfig"
osource "D:/zephyr-course/deps/zephyr/soc/microchip/sam/sam_d5x_e5x/Kconfig"
osource "D:/zephyr-course/deps/zephyr/soc/microchip/pic64/Kconfig"
osource "D:/zephyr-course/deps/zephyr/soc/microchip/pic32c/pic32cz_ca/Kconfig"
osource "D:/zephyr-course/deps/zephyr/soc/microchip/pic32c/pic32cx_sg/Kconfig"
osource "D:/zephyr-course/deps/zephyr/soc/microchip/pic32c/pic32cm_pl/Kconfig"
osource "D:/zephyr-course/deps/zephyr/soc/microchip/pic32c/pic32cm_jh/Kconfig"
osource "D:/zephyr-course/deps/zephyr/soc/microchip/miv/Kconfig"
osource "D:/zephyr-course/deps/zephyr/soc/microchip/mec/Kconfig"
osource "D:/zephyr-course/deps/zephyr/soc/mediatek/mt8xxx/Kconfig"
osource "D:/zephyr-course/deps/zephyr/soc/lowrisc/opentitan/Kconfig"
osource "D:/zephyr-course/deps/zephyr/soc/litex/litex_vexriscv/Kconfig"
osource "D:/zephyr-course/deps/zephyr/soc/ite/ec/Kconfig"
osource "D:/zephyr-course/deps/zephyr/soc/intel/wildcat_lake/Kconfig"
osource "D:/zephyr-course/deps/zephyr/soc/intel/raptor_lake/Kconfig"
osource "D:/zephyr-course/deps/zephyr/soc/intel/panther_lake/Kconfig"
osource "D:/zephyr-course/deps/zephyr/soc/intel/lakemont/Kconfig"
osource "D:/zephyr-course/deps/zephyr/soc/intel/intel_socfpga_std/Kconfig"
osource "D:/zephyr-course/deps/zephyr/soc/intel/intel_socfpga/Kconfig"
osource "D:/zephyr-course/deps/zephyr/soc/intel/intel_niosv/Kconfig"
osource "D:/zephyr-course/deps/zephyr/soc/intel/intel_ish/Kconfig"
osource "D:/zephyr-course/deps/zephyr/soc/intel/intel_adsp/Kconfig"
osource "D:/zephyr-course/deps/zephyr/soc/intel/elkhart_lake/Kconfig"
osource "D:/zephyr-course/deps/zephyr/soc/intel/atom/Kconfig"
osource "D:/zephyr-course/deps/zephyr/soc/intel/apollo_lake/Kconfig"
osource "D:/zephyr-course/deps/zephyr/soc/intel/alder_lake/Kconfig"
osource "D:/zephyr-course/deps/zephyr/soc/infineon/psoc4/Kconfig"
osource "D:/zephyr-course/deps/zephyr/soc/infineon/edge/Kconfig"
osource "D:/zephyr-course/deps/zephyr/soc/infineon/cat3/Kconfig"
osource "D:/zephyr-course/deps/zephyr/soc/infineon/cat1c/Kconfig"
osource "D:/zephyr-course/deps/zephyr/soc/infineon/cat1b/Kconfig"
osource "D:/zephyr-course/deps/zephyr/soc/infineon/cat1a/Kconfig"
osource "D:/zephyr-course/deps/zephyr/soc/gd/gd32/Kconfig"
osource "D:/zephyr-course/deps/zephyr/soc/gaisler/leon3/Kconfig"
osource "D:/zephyr-course/deps/zephyr/soc/gaisler/gr716a/Kconfig"
osource "D:/zephyr-course/deps/zephyr/soc/focaltech/Kconfig"
osource "D:/zephyr-course/deps/zephyr/soc/espressif/Kconfig"
osource "D:/zephyr-course/deps/zephyr/soc/ene/kb1200/Kconfig"
osource "D:/zephyr-course/deps/zephyr/soc/ene/kb106x/Kconfig"
osource "D:/zephyr-course/deps/zephyr/soc/elan/em32f967/Kconfig"
osource "D:/zephyr-course/deps/zephyr/soc/egis/Kconfig"
osource "D:/zephyr-course/deps/zephyr/soc/efinix/sapphire/Kconfig"
osource "D:/zephyr-course/deps/zephyr/soc/cdns/xtensa_sample_controller/Kconfig"
osource "D:/zephyr-course/deps/zephyr/soc/cdns/swerv/Kconfig"
osource "D:/zephyr-course/deps/zephyr/soc/cdns/sample_controller32/Kconfig"
osource "D:/zephyr-course/deps/zephyr/soc/cdns/dc233c/Kconfig"
osource "D:/zephyr-course/deps/zephyr/soc/brcm/bcmvk/Kconfig"
osource "D:/zephyr-course/deps/zephyr/soc/brcm/bcm2712/Kconfig"
osource "D:/zephyr-course/deps/zephyr/soc/brcm/bcm2711/Kconfig"
osource "D:/zephyr-course/deps/zephyr/soc/blackberry/qnxhv_vm/Kconfig"
osource "D:/zephyr-course/deps/zephyr/soc/bflb/Kconfig"
osource "D:/zephyr-course/deps/zephyr/soc/atmel/sam0/Kconfig"
osource "D:/zephyr-course/deps/zephyr/soc/atmel/sam/Kconfig"
osource "D:/zephyr-course/deps/zephyr/soc/aspeed/Kconfig"
osource "D:/zephyr-course/deps/zephyr/soc/arm/Kconfig"
osource "D:/zephyr-course/deps/zephyr/soc/arm/beetle/Kconfig"
osource "D:/zephyr-course/deps/zephyr/soc/antmicro/myra/Kconfig"
osource "D:/zephyr-course/deps/zephyr/soc/andestech/Kconfig"
osource "D:/zephyr-course/deps/zephyr/soc/amd/acp_6_0/Kconfig"
osource "D:/zephyr-course/deps/zephyr/soc/ambiq/Kconfig"
osource "D:/zephyr-course/deps/zephyr/soc/allwinner/sun8i_h3/Kconfig"
osource "D:/zephyr-course/deps/zephyr/soc/alif/ensemble/Kconfig"
osource "D:/zephyr-course/deps/zephyr/soc/aesc/Kconfig"
osource "D:/zephyr-course/deps/zephyr/soc/adi/max32/Kconfig"
```
